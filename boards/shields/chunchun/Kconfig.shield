## boards/shields/chunchun/Kconfig.shield
```kconfig
# Copyright (c) 2026 vuhk
# SPDX-License-Identifier: MIT

config SHIELD_CHUNCHUN_LEFT
    def_bool $(shields_list_contains,chunchun_left)

config SHIELD_CHUNCHUN_RIGHT
    def_bool $(shields_list_contains,chunchun_right)
```
